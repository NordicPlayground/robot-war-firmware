## CMakeLists.txt
```
#
# Copyright (c) 2019 Nordic Semiconductor
#
# SPDX-License-Identifier: LicenseRef-Nordic-5-Clause
#

cmake_minimum_required(VERSION 3.20.0)

if(EXISTS "${CMAKE_CURRENT_SOURCE_DIR}/dev_options.conf")
    message(WARNING "Using dev_options.conf. Ensure any critical settings are moved to prj.conf before committing to source control.")
    list(APPEND CONF_FILE "${CMAKE_CURRENT_SOURCE_DIR}/dev_options.conf")
endif()

find_package(Zephyr REQUIRED HINTS $ENV{ZEPHYR_BASE})
project(gateway)


# Include application application event headers
zephyr_library_include_directories(src/events)
zephyr_library_include_directories(src/cloud)

# NORDIC SDK APP START
target_sources(app PRIVATE 
    src/main.c
)

include_directories(
    src
)


add_subdirectory(src/cloud)
add_subdirectory(src/modules)
add_subdirectory(src/events)

# NORDIC SDK APP END
```

## Kconfig
```
#
# Copyright (c) 2021 Nordic Semiconductor ASA
#
# SPDX-License-Identifier: LicenseRef-Nordic-5-Clause
#

menu "Gateway"

config GATEWAY_APP_VERSION
	string "Asset Tracker application firmware version"
	default "0.0.0-development"

config GATEWAY_APP_VERSION_MAX_LEN
	int "Maximum length of the application firmware version"
	default 150

rsource "src/modules/Kconfig.*_module"

endmenu

menu "Zephyr Kernel"
source "Kconfig.zephyr"
endmenu

# module = APPLICATION_MODULE
# module-str = Application module
# source "subsys/logging/Kconfig.template.log_config"
```

## prj.conf
```kconfig
#
# Copyright (c) 2019 Nordic Semiconductor ASA
#
# SPDX-License-Identifier: LicenseRef-Nordic-5-Clause
#

# Logger configuration
CONFIG_LOG=y
CONFIG_LOG_DEFAULT_LEVEL=4
# CONFIG_LOG_BACKEND_UART=y

CONFIG_USE_SEGGER_RTT=y
CONFIG_LOG_BACKEND_RTT=y
CONFIG_LOG_BACKEND_UART=n

# General config
CONFIG_NEWLIB_LIBC=y
CONFIG_NEWLIB_LIBC_FLOAT_PRINTF=y

# Modem library
CONFIG_NRF_MODEM_LIB=y

# Networking
CONFIG_NETWORKING=y
CONFIG_NET_NATIVE=n
CONFIG_NET_SOCKETS=y
CONFIG_NET_SOCKETS_OFFLOAD=y
CONFIG_NET_IPV6=y
CONFIG_NET_IPV4=y
CONFIG_NET_SOCKETS_POSIX_NAMES=y

# LTE link control
CONFIG_LTE_AUTO_INIT_AND_CONNECT=n
CONFIG_LTE_NETWORK_MODE_LTE_M=y
CONFIG_LTE_LINK_CONTROL=y

# Configuration required by Application Event Manager
CONFIG_APP_EVENT_MANAGER=y
CONFIG_APP_EVENT_MANAGER_LOG_EVENT_TYPE=n

# Memory
CONFIG_MAIN_STACK_SIZE=4096
CONFIG_HEAP_MEM_POOL_SIZE=2048

CONFIG_DEBUG_OPTIMIZATIONS=y
CONFIG_DEBUG_THREAD_INFO=y

# Button support
CONFIG_DK_LIBRARY=y

# cJSON - Used in cloud data encoding.
CONFIG_CJSON_LIB=y

# AWS IOT
CONFIG_AWS_IOT=y
CONFIG_AWS_IOT_TOPIC_UPDATE_DELTA_SUBSCRIBE=y
CONFIG_AWS_IOT_CONNECTION_POLL_THREAD=n
CONFIG_AWS_IOT_AUTO_DEVICE_SHADOW_REQUEST=n
CONFIG_AWS_IOT_MQTT_RX_TX_BUFFER_LEN=2048

# Options that must be configured in order to establish a connection.
CONFIG_AWS_IOT_SEC_TAG=42
CONFIG_AWS_IOT_BROKER_HOST_NAME="amp6pwoz1i14f-ats.iot.us-east-2.amazonaws.com"
# CONFIG_AWS_IOT_CLIENT_ID_STATIC="gameController"
CONFIG_AWS_IOT_CLIENT_ID_STATIC="robot_wars_gateway"

# MQTT Transport library
# Maximum specified MQTT keepalive timeout for AWS IoT is 1200 seconds.
CONFIG_MQTT_KEEPALIVE=1200

CONFIG_QOS=y
CONFIG_QOS_PENDING_MESSAGES_MAX=15
CONFIG_QOS_MESSAGE_NOTIFIED_COUNT_MAX=3
CONFIG_QOS_MESSAGE_NOTIFY_TIMEOUT_SECONDS=16


# UART
CONFIG_UART_ASYNC_API=y
CONFIG_UART_2_NRF_HW_ASYNC=y
CONFIG_UART_2_NRF_HW_ASYNC_TIMER=2

CONFIG_MODEM_MODULE_LOG_LEVEL_INF=y
CONFIG_CLOUD_MODULE_LOG_LEVEL_INF=y
CONFIG_NET_WEBSOCKET_LOG_LEVEL_DBG=y
```

## src/main.c
```c
/*
 * Copyright (c) 2019 Nordic Semiconductor ASA
 *
 * SPDX-License-Identifier: LicenseRef-Nordic-5-Clause
 */

#include <app_event_manager.h>
#include <zephyr/logging/log.h>

#define MODULE main

#include <zephyr/logging/log.h>
LOG_MODULE_REGISTER(MODULE);

void main(void)
{
	if (app_event_manager_init()) {
		LOG_ERR("Application Event Manager not initialized");
	} 
}
```
