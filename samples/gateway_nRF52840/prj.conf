## CMakeLists.txt
```
#
# Copyright (c) 2019 Nordic Semiconductor
#
# SPDX-License-Identifier: LicenseRef-Nordic-5-Clause
#

cmake_minimum_required(VERSION 3.20.0)

if(EXISTS "${CMAKE_CURRENT_SOURCE_DIR}/dev_options.conf")
    message(WARNING "Using dev_options.conf. Ensure any critical settings are moved to prj.conf before committing to source control.")
    list(APPEND CONF_FILE "${CMAKE_CURRENT_SOURCE_DIR}/dev_options.conf")
endif()

find_package(Zephyr REQUIRED HINTS $ENV{ZEPHYR_BASE})
project(mesh_bot)


# NORDIC SDK APP START
target_sources(app PRIVATE 
    src/main.c
    src/model_handler.c
    src/uart_handler.c
)

include_directories(
    src
)
# NORDIC SDK APP END
```

## prj.conf
```kconfig
#
# Copyright (c) 2019 Nordic Semiconductor ASA
#
# SPDX-License-Identifier: LicenseRef-Nordic-5-Clause
#


# Logger configuration
CONFIG_LOG=y
CONFIG_LOG_DEFAULT_LEVEL=4
CONFIG_LOG_BACKEND_UART=y

# Memory
CONFIG_MAIN_STACK_SIZE=4096
CONFIG_HEAP_MEM_POOL_SIZE=2048

# NewLib C
CONFIG_NEWLIB_LIBC=y


# Debug
CONFIG_DEBUG_OPTIMIZATIONS=y
CONFIG_DEBUG_THREAD_INFO=y


# Memory
CONFIG_SYSTEM_WORKQUEUE_STACK_SIZE=2048
CONFIG_FLASH=y
CONFIG_FLASH_MAP=y
CONFIG_NVS=y
CONFIG_PARTITION_MANAGER_ENABLED=y
CONFIG_PM_SINGLE_IMAGE=y
CONFIG_PM_PARTITION_SIZE_SETTINGS_STORAGE=0x8000

# DK specific configs
CONFIG_DK_LIBRARY=y
CONFIG_HWINFO=y

# Settings
CONFIG_SETTINGS=y
CONFIG_BT_SETTINGS=y

# UART
CONFIG_SERIAL=y
CONFIG_UART_ASYNC_API=y
CONFIG_UART_1_NRF_HW_ASYNC=y
CONFIG_UART_1_NRF_HW_ASYNC_TIMER=2
CONFIG_UART_LINE_CTRL=y

# Bluetooth
CONFIG_BT=y
CONFIG_BT_COMPANY_ID=0x0059
CONFIG_BT_DEVICE_NAME="nRF Robot War Gateway"
CONFIG_BT_L2CAP_TX_MTU=69
CONFIG_BT_L2CAP_TX_BUF_COUNT=8
CONFIG_BT_OBSERVER=y
CONFIG_BT_PERIPHERAL=y
CONFIG_BT_RX_STACK_SIZE=4096
CONFIG_BT_ECC=y
CONFIG_BT_TINYCRYPT_ECC=y

CONFIG_BT_WAIT_NOP=n

# Bluetooth mesh
CONFIG_BT_MESH=y
CONFIG_BT_MESH_RELAY=y
CONFIG_BT_MESH_FRIEND=y
CONFIG_BT_MESH_ADV_BUF_COUNT=13
CONFIG_BT_MESH_RX_SEG_MAX=10
CONFIG_BT_MESH_TX_SEG_MAX=10
CONFIG_BT_MESH_PB_GATT=y
CONFIG_BT_MESH_GATT_PROXY=y
CONFIG_BT_MESH_DK_PROV=y
CONFIG_BT_MESH_MODEL_EXTENSIONS=y

CONFIG_BT_MESH_ROBOT_CLI=y
```

## src/model_handler copy.c
```c
#include <zephyr/sys/byteorder.h>
#include <zephyr/bluetooth/mesh/msg.h>

#include "../../common/mesh_model_defines/robot_movement_cli.h"
#include "model_handler.h"
#include "robot_movement_cli.h"

/* SIG models */

static void attention_on(struct bt_mesh_model *model)
{
    printk("attention_on()\n");
}

static void attention_off(struct bt_mesh_model *model)
{
    printk("attention_off()\n");
}

static const struct bt_mesh_health_srv_cb health_srv_cb = {
    .attn_on = attention_on,
    .attn_off = attention_off,
};

static struct bt_mesh_health_srv health_srv = {
    .cb = &health_srv_cb,
};

BT_MESH_HEALTH_PUB_DEFINE(health_pub, 0);

static struct bt_mesh_model sig_models[] = {
    BT_MESH_MODEL_CFG_SRV,
    BT_MESH_MODEL_HEALTH_SRV(&health_srv, &health_pub),
};

/* Vendor models */

struct bt_mesh_robot_config_cli robot_conf_cli;

static struct bt_mesh_model vendor_models[] = {
    BT_MESH_MODEL_VND_ROBOT_CONFIG_CLI(&robot_conf_cli),
};

/* Composition */
static struct bt_mesh_elem elements[] = {
    BT_MESH_ELEM(0, sig_models, vendor_models),
};

static struct bt_mesh_comp comp = {
    .cid = CONFIG_BT_COMPANY_ID,
    .elem = elements,
    .elem_count = ARRAY_SIZE(elements),
};

const struct bt_mesh_comp *model_handler_init(void)
{
    *config_client = &robot_conf_cli;
    (*config_client)->model = &vendor_models[0];
    bt_mesh_msg_ack_ctx_init(&(*config_client)->ack_ctx);
    return &comp;
}
```

## src/model_handler.c
```c
#include <zephyr/sys/byteorder.h>
#include <zephyr/bluetooth/mesh/msg.h>
#include <bluetooth/mesh/models.h>


#include "model_handler.h"
#include <zephyr/logging/log.h>
LOG_MODULE_REGISTER(model_handler);

struct model_handlers *app_handlers;

/* SIG models */
static void attention_on(struct bt_mesh_model *model)
{
    printk("attention_on()\n");
}

static void attention_off(struct bt_mesh_model *model)
{
    printk("attention_off()\n");
}

static const struct bt_mesh_health_srv_cb health_srv_cb = {
    .attn_on = attention_on,
    .attn_off = attention_off,
};

static struct bt_mesh_health_srv health_srv = {
    .cb = &health_srv_cb,
};

BT_MESH_HEALTH_PUB_DEFINE(health_pub, 0);




void app_handle_rx(void *data, size_t len, uint32_t opcode, uint16_t model_id, uint16_t addr)
{
    if (app_handlers) {
        if (app_handlers->rx) {
            app_handlers->rx((uint8_t *)data, len, opcode, model_id, addr);
        }
    }
}

void handle_robot_id(struct bt_mesh_robot_cli *cli, struct bt_mesh_id_status id, struct bt_mesh_msg_ctx *ctx) 
{    
	LOG_HEXDUMP_INF(id.id, CONFIG_BT_MESH_ID_LEN, "Id detected:");
    app_handle_rx(&id, sizeof(struct bt_mesh_id_status), BT_MESH_ID_OP_STATUS, ID_CLI_MODEL_ID, ctx->addr);
}

void handle_robot_movement_configured(struct bt_mesh_robot_cli *cli, struct bt_mesh_msg_ctx *ctx) 
{    
	LOG_INF("movement configured on addr %x", ctx->addr);
    uint8_t ack = 0;
    app_handle_rx(&ack, sizeof(uint8_t), BT_MESH_MOVEMENT_OP_MOVEMENT_ACK, MOVEMENT_CLI_MODEL_ID, ctx->addr);
}

/* Vendor models */
static const struct bt_mesh_robot_cli_handlers robot_cb = {
	.id = handle_robot_id,
    .movement_configured = handle_robot_movement_configured,
};

struct bt_mesh_robot_cli robot = BT_MESH_ROBOT_CLI_INIT(&robot_cb);

struct bt_mesh_light_rgb_cli light_rgb;

/* Composition */
static struct bt_mesh_elem elements[] = {
    BT_MESH_ELEM(
		0,
        BT_MESH_MODEL_LIST(
            BT_MESH_MODEL_CFG_SRV,
            BT_MESH_MODEL_HEALTH_SRV(&health_srv, &health_pub)
        ),
        BT_MESH_MODEL_LIST( 
            BT_MESH_MODEL_ROBOT_CLI(&robot),
            BT_MESH_MODEL_LIGHT_RGB_CLI(&light_rgb)
        )
    )
};

static struct bt_mesh_comp comp = {
    .cid = CONFIG_BT_COMPANY_ID,
    .elem = elements,
    .elem_count = ARRAY_SIZE(elements),
};

const struct bt_mesh_comp *model_handler_init(struct model_handlers *handlers)
{
    app_handlers = handlers;
    return &comp;
}

int mesh_tx(uint8_t *data, uint8_t len, uint32_t type, uint16_t model_id, uint16_t addr)
{
    switch (model_id)
	{
	case MOVEMENT_CLI_MODEL_ID:
	{
		if (type == BT_MESH_MOVEMENT_OP_MOVEMENT_SET) {
            struct bt_mesh_movement_set set;

            struct bt_mesh_msg_ctx ctx = {
                .addr = addr,
                .app_idx = robot.model->keys[0],
                .send_ttl = BT_MESH_TTL_DEFAULT
            };

            uint8_t *set_ptr = (uint8_t*)&set;
	        memcpy(set_ptr, data, sizeof(uint32_t));

            set_ptr = set_ptr + sizeof(uint32_t);
            data = data +  sizeof(uint32_t);
            memcpy(set_ptr, data, sizeof(uint32_t));

            set_ptr = set_ptr + sizeof(uint32_t);
            data = data +  sizeof(uint32_t);
            memcpy(set_ptr, data, sizeof(uint8_t));

            
            bt_mesh_robot_cli_movement_set(&robot, &ctx, set);
		}
        else if (type == BT_MESH_MOVEMENT_OP_READY_SET) {

            struct bt_mesh_msg_ctx ctx = {
                .addr = 0xFFFF,
                .app_idx = robot.model->keys[0],
                .send_ttl = BT_MESH_TTL_DEFAULT
            };

            bt_mesh_robot_cli_ready_set(&robot, &ctx);
		}
	} break;
	case LIGHT_RGB_CLI_MODEL_ID:
    {
        if (type == BT_MESH_LIGHT_RGB_OP_RGB_SET) {
            struct bt_mesh_light_rgb_set set;

            struct bt_mesh_msg_ctx ctx = {
                .addr = addr,
                .app_idx = light_rgb.model->keys[0],
                .send_ttl = BT_MESH_TTL_DEFAULT
            };

            uint8_t *set_ptr = (uint8_t*)&set;
	        memcpy(set_ptr, data, sizeof(uint16_t));

            set_ptr = set_ptr + sizeof(uint16_t);
            data = data +  sizeof(uint16_t);
            memcpy(set_ptr, data, sizeof(uint8_t));

            set_ptr = set_ptr + sizeof(uint8_t);
            data = data +  sizeof(uint8_t);
            memcpy(set_ptr, data, sizeof(uint8_t));
            
            set_ptr = set_ptr + sizeof(uint8_t);
            data = data +  sizeof(uint8_t);
            memcpy(set_ptr, data, sizeof(uint8_t));

            bt_mesh_light_rgb_cli_rgb_set(&light_rgb, &ctx, set);
		}
    } break;
   
	default:
		break;
	}
    return 0;
}
```

## src/model_handler.h
```c
/*
 * Copyright (c) 2019 Nordic Semiconductor ASA
 *
 * SPDX-License-Identifier: LicenseRef-Nordic-5-Clause
 */


#ifndef MODEL_HANDLER_H__
#define MODEL_HANDLER_H__

#include <zephyr/bluetooth/mesh.h>
#include "bluetooth/mesh/vnd/robot_cli.h"
#include "bluetooth/mesh/vnd/light_rgb_cli.h"

#ifdef __cplusplus
extern "C" {
#endif

/** Uart message handlers. */
struct model_handlers {
    /** @brief Handler for receiving messages.
	 *
	 * @param[in] data Pointer to message payload.
	 * @param[in] len Length of payload data.
	 * @param[in] type Type of payload.
	 * @param[in] add addr of client.
	 */
    void (*rx)(uint8_t *data, uint8_t len, uint32_t type, uint16_t model_id, uint16_t addr);
    /** @brief Handler for message tx done.
     * 
	 * @param[in] data Pointer to message payload.
	 * @param[in] len Length of payload data.
	 */
    void (*tx_done)(uint8_t *data, uint8_t len);
};

const struct bt_mesh_comp *model_handler_init(struct model_handlers *handlers);

int mesh_tx(uint8_t *data, uint8_t len, uint32_t type, uint16_t model_id, uint16_t addr);
int set_movement(uint16_t addr, uint32_t time, uint32_t rotation, uint8_t speed);

#ifdef __cplusplus
}
#endif

#endif /* MODEL_HANDLER_H__ */
```

## src/uart_handler copy.c
```c
#include <zephyr.h>
#include <zephyr/drivers/uart.h>

// #include "./robot_movement_cli.h"
#include "uart_handler.h"

#define MODULE uart

#include <zephyr/logging/log.h>
LOG_MODULE_REGISTER(MODULE, CONFIG_UART_MODULE_LOG_LEVEL);

struct uart_thread_msg
{
	struct device *uart_dev;
	struct bt_mesh_robot_config_cli *config_client;
	union mesh_uart_msg msg;
};
K_MSGQ_DEFINE(uart_msg_queue, sizeof(struct uart_thread_msg), 4, 4);

K_MEM_SLAB_DEFINE_STATIC(mesh_uart_rx_slab, CONFIG_MESH_UART_RX_BUF_SIZE, CONFIG_MESH_UART_RX_BUF_COUNT, 4);

static int uart_data_rx_rdy_handler(const struct device *dev, struct uart_event_rx event_data, struct bt_mesh_robot_config_cli *config_client)
{
	static union mesh_uart_msg msg;
	static size_t current_msg_len = 0; // Length of currently received fragment

	uint8_t *msg_fill_start = ((uint8_t *)&msg) + current_msg_len;
	memcpy(msg_fill_start, (event_data.buf + event_data.offset), event_data.len);
	current_msg_len += event_data.len;

	LOG_DBG("Message fragment received: length: %d offset: %d", event_data.len, event_data.offset);
	if (current_msg_len < sizeof(msg.header))
	{
		return 0; // Header not yet received. Keep waiting for more data.
	}

	struct uart_thread_msg thread_msg; // Prepare message for message queue
	thread_msg.uart_dev = dev;
	thread_msg.config_client = config_client;
	thread_msg.msg = msg;

	LOG_DBG("Got message with type %d", msg.header.type);
	switch (msg.header.type)
	{
	case HELLO:
	{
		if (current_msg_len < sizeof(msg.hello))
		{
			return 0; // Message not complete. Keep waiting for more data.
		}
		LOG_DBG("UART \"HELLO\" received");
		int err = k_msgq_put(&uart_msg_queue, &thread_msg, K_NO_WAIT);
		if (err)
		{
			LOG_ERR("Failed to enqueue message: Error %d", err);
		}
		break;
	}
	case CLEAR_TO_MOVE:
	{
		if (current_msg_len < sizeof(msg.clear_to_move))
		{
			return 0; // Message not complete. Keep waiting for more data.
		}
		LOG_DBG("UART \"CLEAR_TO_MOVE\" received");
		int err = k_msgq_put(&uart_msg_queue, &thread_msg, K_NO_WAIT);
		if (err)
		{
			LOG_ERR("Failed to enqueue message: Error %d", err);
		}
		break;
	}
	case SET_MOVEMENT_CONFIG:
	{
		if (current_msg_len < sizeof(msg.set_movement_config))
		{
			return 0; // Message not complete. Keep waiting for more data.
		}
		LOG_DBG("UART \"SET_MOVEMENT_CONFIG\" received");
		int err = k_msgq_put(&uart_msg_queue, &thread_msg, K_NO_WAIT);
		if (err)
		{
			LOG_ERR("Failed to enqueue message: Error %d", err);
		}
		break;
	}
	default:
	{
		LOG_ERR("Unknown message type %d", msg.header.type);
		current_msg_len = 0;
		return -EINVAL;
	}
	}
	current_msg_len = 0;

	return 0;
}

static K_SEM_DEFINE(uart_tx_sem, 1, 1);
static int mesh_uart_send(const struct device *dev, void *data, size_t len, k_timeout_t timeout)
{
	int err = k_sem_take(&uart_tx_sem, timeout);
	if (err)
	{
		LOG_ERR("Failed to take semaphore: Error %d", err);
		return err;
	}
	err = uart_tx(dev, data, len, SYS_FOREVER_US);
	if (err)
	{
		LOG_ERR("Failed to send data: Error %d", err);
		return err;
	}
	return 0;
}

static int mesh_uart_send_status(const struct device *dev, int status, k_timeout_t timeout)
{
	static struct mesh_uart_status_msg msg;
	msg.header.type = STATUS;
	msg.data.status = status;
	return mesh_uart_send(dev, &msg, sizeof(msg), timeout);
}

static int mesh_uart_send_hello(const struct device *dev, uint16_t echo, k_timeout_t timeout)
{
	static struct mesh_uart_hello_msg msg;
	msg.header.type = HELLO;
	msg.echo = echo;
	return mesh_uart_send(dev, &msg, sizeof(msg), timeout);
}

static int mesh_uart_send_movement_config_accepted(const struct device *dev, struct mesh_uart_movement_config config, k_timeout_t timeout)
{
	static struct mesh_uart_movement_config_accepted_msg msg;
	msg.header.type = MOVEMENT_CONFIG_ACCEPTED;
	msg.data = config;
	return mesh_uart_send(dev, &msg, sizeof(msg), timeout);
}

static void uart_callback(const struct device *dev, struct uart_event *event, void *user_data)
{
	struct bt_mesh_robot_config_cli *config_client = (struct bt_mesh_robot_config_cli *)user_data;
	switch (event->type)
	{
	case UART_TX_DONE:
	{
		LOG_DBG("UART_TX_DONE: Sent %d bytes", event->data.tx.len);
		k_sem_give(&uart_tx_sem);
		break;
	}
	case UART_TX_ABORTED:
	{
		LOG_ERR("UART_TX_ABORTED");
		k_sem_give(&uart_tx_sem);
		break;
	}
	case UART_RX_RDY:
	{
		LOG_DBG("UART_RX_RDY");
		uart_data_rx_rdy_handler(dev, event->data.rx, config_client);
		break;
	}
	case UART_RX_BUF_REQUEST:
	{
		LOG_DBG("UART_RX_BUF_REQUEST");
		void *new_buf;
		int err = k_mem_slab_alloc(&mesh_uart_rx_slab, &new_buf, K_NO_WAIT);
		if (err)
		{
			LOG_ERR("Could not allocate new buffer: Error %d", err);
		}
		else
		{
			err = uart_rx_buf_rsp(dev, new_buf, CONFIG_MESH_UART_RX_BUF_SIZE);
			if (err)
			{
				LOG_ERR("Could not set new buffer: Error %d", err);
			}
		}
		break;
	}
	case UART_RX_BUF_RELEASED:
	{
		LOG_DBG("UART_RX_BUF_RELEASED");
		k_mem_slab_free(&mesh_uart_rx_slab, (void **)&event->data.rx_buf.buf);
		break;
	}
	case UART_RX_DISABLED:
	{
		LOG_DBG("UART_RX_DISABLED");
		break;
	}
	case UART_RX_STOPPED:
	{
		LOG_DBG("UART_RX_STOPPED: Reason: %d", event->data.rx_stop.reason);
		break;
	}
	default:
		LOG_ERR("Unknown UART event type %d", event->type);
		break;
	}
}

int init_uart(const struct device *uart_dev)
{
	int err = 0;

	if (!device_is_ready(uart_dev))
	{
		LOG_ERR("UART device not ready");
		return -ENODEV;
	}
	LOG_DBG("UART device ready");

	err = uart_callback_set(uart_dev, uart_callback, NULL/*(void *)config_client*/);
	if (err)
	{
		LOG_ERR("Failed to set UART callback: Error %d", err);
		return err;
	}
	void *initial_rx_buf;
	err = k_mem_slab_alloc(&mesh_uart_rx_slab, &initial_rx_buf, K_NO_WAIT);
	if (err)
	{
		LOG_ERR("Could not allocate initial RX buffer");
		return err;
	}
	uart_rx_enable(uart_dev, initial_rx_buf, CONFIG_MESH_UART_RX_BUF_SIZE, 1000);
	return 0;
}

static void uart_thread_fn(void *arg1, void *arg2, void *arg3)
{
	LOG_DBG("Starting UART thread");
	struct uart_thread_msg thread_msg;
	while (true)
	{
		int err = k_msgq_get(&uart_msg_queue, &thread_msg, K_FOREVER);
		if (err)
		{
			LOG_ERR("Failed to dequeue message: Error %d", err);
			continue;
		}
		
	}
}

K_THREAD_DEFINE(uart_thread, CONFIG_UART_THREAD_STACK_SIZE, uart_thread_fn, NULL, NULL, NULL, CONFIG_UART_THREAD_PRIORITY, 0, 0);
```

## src/uart_handler.h
```c
/*
 * Copyright (c) 2019 Nordic Semiconductor ASA
 *
 * SPDX-License-Identifier: LicenseRef-Nordic-5-Clause
 */


#ifndef UART_HANDLER_H__
#define UART_HANDLER_H__

#include <zephyr/device.h>
#include <zephyr/drivers/uart.h>

#ifdef __cplusplus
extern "C" {
#endif

/** Uart message handlers. */
struct uart_msg_handlers {
    /** @brief Handler for receiving messages.
	 *
	 * @param[in] dev Uart device.
	 * @param[in] data Pointer to message payload.
	 * @param[in] len Length of payload data.
	 * @param[in] type Type of payload.
	 */
    void (*rx)(const struct device *dev, uint8_t *data, uint8_t len, uint32_t type, uint16_t id, uint16_t addr);
    /** @brief Handler for message tx done.
     * 
	 *
	 * @param[in] dev Uart device.
	 * @param[in] data Pointer to message payload.
	 * @param[in] len Length of payload data.
	 */
    void (*tx_done)(const struct device *dev, const uint8_t *data, uint8_t len);
};

/** @brief Send a message over the uart bridge.
 *
 * @param[in] dev Uart device.
 * @param[in] data Pointer to message payload.
 * @param[in] len Length of payload data.
 * @param[in] type Type of payload.
 */
int uart_send(const struct device *dev, uint8_t *data, uint32_t len, uint32_t type, uint32_t id, uint32_t addr);

/** @brief Initialize the uart message bridge.
 *
 * @param[in] dev Uart device.
 * @param[in] handlers handlers.
 */
int init_uart(const struct device *dev, struct uart_msg_handlers *handlers);


#ifdef __cplusplus
}
#endif

#endif /* UART_HANDLER_H__ */
```
