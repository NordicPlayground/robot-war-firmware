## Kconfig
```
#
# Copyright (c) 2021 Nordic Semiconductor ASA
#
# SPDX-License-Identifier: LicenseRef-Nordic-5-Clause
#

# rsource "src/models/Kconfig"

menu "Gateway nRF52840"

config GATEWAY_NRF52840_VERSION
	string "Gateway nRF52840 firmware version"
	default "0.0.0-development"

config MESH_ROBOT_VERSION_MAX_LEN
	int "Maximum length of the application firmware version"
	default 150

config MESH_UART_RX_BUF_SIZE
	int "UART RX buffer size"
	default 256

config MESH_UART_RX_BUF_COUNT
	int "UART RX buffer count"
	default 4

config UART_RX_THREAD_STACK_SIZE
	int "UART thread stack size"
	default 2048

config UART_RX_THREAD_PRIORITY
	int "UART thread priority"
	default 5

config UART_TX_THREAD_STACK_SIZE
	int "UART thread stack size"
	default 2048

config UART_TX_THREAD_PRIORITY
	int "UART thread priority"
	default 5

module = APPLICATION_MODULE
module-str = Application module
source "subsys/logging/Kconfig.template.log_config"

module = UART_MODULE
module-str = Uart module
source "subsys/logging/Kconfig.template.log_config"

module = ROBOT_CONFIG_CLIENT
module-str = Robot config client
source "subsys/logging/Kconfig.template.log_config"

endmenu

menu "Zephyr Kernel"
source "Kconfig.zephyr"
endmenu
```

## prj.conf
```kconfig
#
# Copyright (c) 2019 Nordic Semiconductor ASA
#
# SPDX-License-Identifier: LicenseRef-Nordic-5-Clause
#


# Logger configuration
CONFIG_LOG=y
CONFIG_LOG_DEFAULT_LEVEL=4
CONFIG_LOG_BACKEND_UART=y

# Memory
CONFIG_MAIN_STACK_SIZE=4096
CONFIG_HEAP_MEM_POOL_SIZE=2048

# NewLib C
CONFIG_NEWLIB_LIBC=y


# Debug
CONFIG_DEBUG_OPTIMIZATIONS=y
CONFIG_DEBUG_THREAD_INFO=y


# Memory
CONFIG_SYSTEM_WORKQUEUE_STACK_SIZE=2048
CONFIG_FLASH=y
CONFIG_FLASH_MAP=y
CONFIG_NVS=y
CONFIG_PARTITION_MANAGER_ENABLED=y
CONFIG_PM_SINGLE_IMAGE=y
CONFIG_PM_PARTITION_SIZE_SETTINGS_STORAGE=0x8000

# DK specific configs
CONFIG_DK_LIBRARY=y
CONFIG_HWINFO=y

# Settings
CONFIG_SETTINGS=y
CONFIG_BT_SETTINGS=y

# UART
CONFIG_SERIAL=y
CONFIG_UART_ASYNC_API=y
CONFIG_UART_1_NRF_HW_ASYNC=y
CONFIG_UART_1_NRF_HW_ASYNC_TIMER=2
CONFIG_UART_LINE_CTRL=y

# Bluetooth
CONFIG_BT=y
CONFIG_BT_COMPANY_ID=0x0059
CONFIG_BT_DEVICE_NAME="nRF Robot War Gateway"
CONFIG_BT_L2CAP_TX_MTU=69
CONFIG_BT_L2CAP_TX_BUF_COUNT=8
CONFIG_BT_OBSERVER=y
CONFIG_BT_PERIPHERAL=y
CONFIG_BT_RX_STACK_SIZE=4096
CONFIG_BT_ECC=y
CONFIG_BT_TINYCRYPT_ECC=y

CONFIG_BT_WAIT_NOP=n

# Bluetooth mesh
CONFIG_BT_MESH=y
CONFIG_BT_MESH_RELAY=y
CONFIG_BT_MESH_FRIEND=y
CONFIG_BT_MESH_ADV_BUF_COUNT=13
CONFIG_BT_MESH_PB_GATT=y
CONFIG_BT_MESH_GATT_PROXY=y
CONFIG_BT_MESH_DK_PROV=y
CONFIG_BT_MESH_MODEL_EXTENSIONS=y
CONFIG_BT_MESH_RX_SEG_MAX=10
CONFIG_BT_MESH_TX_SEG_MAX=10
CONFIG_BT_MESH_TX_SEG_MSG_COUNT=64
CONFIG_BT_MESH_RX_SEG_MSG_COUNT=64

CONFIG_BT_MESH_ROBOT_CLI=y
CONFIG_BT_MESH_LIGHT_RGB_CLI=y
```

## src/model_handler.c
```c
#include <zephyr/sys/byteorder.h>
#include <zephyr/bluetooth/mesh/msg.h>
#include <bluetooth/mesh/models.h>


#include "model_handler.h"
#include <zephyr/logging/log.h>
LOG_MODULE_REGISTER(model_handler);

struct model_handlers *app_handlers;

/* SIG models */
static void attention_on(struct bt_mesh_model *model)
{
    printk("attention_on()\n");
}

static void attention_off(struct bt_mesh_model *model)
{
    printk("attention_off()\n");
}

static const struct bt_mesh_health_srv_cb health_srv_cb = {
    .attn_on = attention_on,
    .attn_off = attention_off,
};

static struct bt_mesh_health_srv health_srv = {
    .cb = &health_srv_cb,
};

BT_MESH_HEALTH_PUB_DEFINE(health_pub, 0);




void app_handle_rx(void *data, size_t len, uint32_t opcode, uint16_t model_id, uint16_t addr)
{
    if (app_handlers) {
        if (app_handlers->rx) {
            app_handlers->rx((uint8_t *)data, len, opcode, model_id, addr);
        }
    }
}

void handle_robot_id(struct bt_mesh_robot_cli *cli, struct bt_mesh_id_status id, struct bt_mesh_msg_ctx *ctx) 
{    
	LOG_HEXDUMP_INF(id.id, CONFIG_BT_MESH_ID_LEN, "Id detected:");
    app_handle_rx(&id, sizeof(struct bt_mesh_id_status), BT_MESH_ID_OP_STATUS, ID_CLI_MODEL_ID, ctx->addr);
}

void handle_robot_movement_configured(struct bt_mesh_robot_cli *cli, struct bt_mesh_msg_ctx *ctx) 
{    
	LOG_INF("movement configured on addr %x", ctx->addr);
    uint8_t ack = 0;
    app_handle_rx(&ack, sizeof(uint8_t), BT_MESH_MOVEMENT_OP_MOVEMENT_ACK, MOVEMENT_CLI_MODEL_ID, ctx->addr);
}

void handle_robot_telemetry_reported(struct bt_mesh_robot_cli *cli, struct bt_mesh_telemetry_report report, struct bt_mesh_msg_ctx *ctx) 
{    
	LOG_INF("telemetry reported from addr %x", ctx->addr);
    app_handle_rx(&report, sizeof(struct bt_mesh_telemetry_report), BT_MESH_TELEMETRY_OP_TELEMETRY_REPORT, TELEMETRY_CLI_MODEL_ID, ctx->addr);
}

/* Vendor models */
static const struct bt_mesh_robot_cli_handlers robot_cb = {
	.id = handle_robot_id,
    .movement_configured = handle_robot_movement_configured,
    .telemetry_reported = handle_robot_telemetry_reported,
};

struct bt_mesh_robot_cli robot = BT_MESH_ROBOT_CLI_INIT(&robot_cb);

struct bt_mesh_light_rgb_cli light_rgb;

/* Composition */
static struct bt_mesh_elem elements[] = {
    BT_MESH_ELEM(
		0,
        BT_MESH_MODEL_LIST(
            BT_MESH_MODEL_CFG_SRV,
            BT_MESH_MODEL_HEALTH_SRV(&health_srv, &health_pub)
        ),
        BT_MESH_MODEL_LIST( 
            BT_MESH_MODEL_ROBOT_CLI(&robot),
            BT_MESH_MODEL_LIGHT_RGB_CLI(&light_rgb)
        )
    )
};

static struct bt_mesh_comp comp = {
    .cid = CONFIG_BT_COMPANY_ID,
    .elem = elements,
    .elem_count = ARRAY_SIZE(elements),
};

const struct bt_mesh_comp *model_handler_init(struct model_handlers *handlers)
{
    app_handlers = handlers;
    return &comp;
}

int mesh_tx(uint8_t *data, uint8_t len, uint32_t type, uint16_t model_id, uint16_t addr)
{
    switch (model_id)
	{
	case MOVEMENT_CLI_MODEL_ID:
	{
		if (type == BT_MESH_MOVEMENT_OP_MOVEMENT_SET) {
            struct bt_mesh_movement_set set;

            struct bt_mesh_msg_ctx ctx = {
                .addr = addr,
                .app_idx = robot.model->keys[0],
                .send_ttl = BT_MESH_TTL_DEFAULT
            };

            uint8_t *set_ptr = (uint8_t*)&set;
	        memcpy(set_ptr, data, sizeof(uint32_t));

            set_ptr = set_ptr + sizeof(uint32_t);
            data = data +  sizeof(uint32_t);
            memcpy(set_ptr, data, sizeof(uint32_t));

            set_ptr = set_ptr + sizeof(uint32_t);
            data = data +  sizeof(uint32_t);
            memcpy(set_ptr, data, sizeof(uint8_t));

            
            bt_mesh_robot_cli_movement_set(&robot, &ctx, set);
		}
        else if (type == BT_MESH_MOVEMENT_OP_READY_SET) {

            struct bt_mesh_msg_ctx ctx = {
                .addr = 0xFFFF,
                .app_idx = robot.model->keys[0],
                .send_ttl = BT_MESH_TTL_DEFAULT
            };

            bt_mesh_robot_cli_ready_set(&robot, &ctx);
		}
	} break;
	case LIGHT_RGB_CLI_MODEL_ID:
    {
        if (type == BT_MESH_LIGHT_RGB_OP_RGB_SET) {
            struct bt_mesh_light_rgb_set set;

            struct bt_mesh_msg_ctx ctx = {
                .addr = addr,
                .app_idx = light_rgb.model->keys[0],
                .send_ttl = BT_MESH_TTL_DEFAULT
            };

            uint8_t *set_ptr = (uint8_t*)&set;
	        memcpy(set_ptr, data, sizeof(uint16_t));

            set_ptr = set_ptr + sizeof(uint16_t);
            data = data +  sizeof(uint16_t);
            memcpy(set_ptr, data, sizeof(uint8_t));

            set_ptr = set_ptr + sizeof(uint8_t);
            data = data +  sizeof(uint8_t);
            memcpy(set_ptr, data, sizeof(uint8_t));
            
            set_ptr = set_ptr + sizeof(uint8_t);
            data = data +  sizeof(uint8_t);
            memcpy(set_ptr, data, sizeof(uint8_t));

            bt_mesh_light_rgb_cli_rgb_set(&light_rgb, &ctx, set);
		}
    } break;
   
	default:
		break;
	}
    return 0;
}
```

## src/uart_handler.c
```c
#include <zephyr.h>
#include "uart_handler.h"

#define MODULE uart

#include <zephyr/logging/log.h>
LOG_MODULE_REGISTER(MODULE, CONFIG_UART_MODULE_LOG_LEVEL);

struct uart_msg_header {
    uint32_t len;
    uint32_t type;
    uint32_t id;
	uint32_t addr;
};

struct uart_msg {
    struct uart_msg_header header;
    uint8_t *data;
};

static uint8_t rx_buf[2];

static struct k_fifo rx_fifo;
static struct k_fifo tx_fifo;

static K_SEM_DEFINE(uart_tx_sem, 0, 1);
K_THREAD_STACK_DEFINE(uart_rx_thread_stack, CONFIG_UART_RX_THREAD_STACK_SIZE);
K_THREAD_STACK_DEFINE(uart_tx_thread_stack, CONFIG_UART_TX_THREAD_STACK_SIZE);
static struct k_thread uart_rx_thread_thread;
static struct k_thread uart_tx_thread_thread;

static void uart_rx_thread_fn(void *arg1, void *arg2, void *arg3);
static void uart_tx_thread_fn(void *arg1, void *arg2, void *arg3);

static int uart_data_rx_rdy_handler(const struct device *dev, struct uart_event_rx event_data)
{
	static struct uart_msg *msg;
	static uint8_t *msg_buf;
	static uint8_t *data;
	static size_t current_msg_len = 0;
	static size_t expected_data_len = 0;
	uint8_t header_size = sizeof(struct uart_msg_header);

	if (current_msg_len == 0) {
		/* New message just started, read expected length and allocate data buffer */
		expected_data_len = *(event_data.buf);
		
		msg = (struct uart_msg *)k_malloc(sizeof(struct uart_msg));
		if (!msg){
			LOG_ERR("Unable to allocate msg");
		}
		msg_buf = (uint8_t*)msg;

		if (expected_data_len != 0) {
			data = k_malloc(expected_data_len);
			if (!data){
				LOG_ERR("Unable to allocate msg data buffer");
			}
			msg->data = data;
		} else {
			msg->data = NULL;
		}

		
		
	} 
	if (current_msg_len < header_size) {
		/* Second byte received, read type of message */
		memcpy((void*)(msg_buf + (current_msg_len)), (event_data.buf), 1);
	} else if (expected_data_len != 0) {
		/* Data byte received, store in message*/
		memcpy((void*)(data + (current_msg_len-header_size)), (event_data.buf), 1);
	}

	current_msg_len ++;
	
	if (current_msg_len == (expected_data_len + sizeof(struct uart_msg_header))) {
		/* Mesagge is complete, add to fifo */
		current_msg_len = 0;
		k_fifo_put(&rx_fifo, msg_buf);
		return 0;
	}
	
	/* Continue receiving */
	return 0;
}

static void uart_callback(const struct device *dev, struct uart_event *event, void *user_data)
{
	static uint8_t *released_buf = &rx_buf[1];
	struct uart_msg_handlers *handlers = (struct uart_msg_handlers *)user_data;
	switch (event->type)
	{
	case UART_TX_DONE:
	{
		LOG_DBG("UART_TX_DONE: Sent %d bytes", event->data.tx.len);
		if (handlers) {
			if (handlers->tx_done){
				handlers->tx_done(dev, event->data.tx.buf, event->data.tx.len);
			}
		}
		k_free((void*)event->data.tx.buf);
		k_sem_give(&uart_tx_sem);
		break;
	}
	case UART_TX_ABORTED:
	{
		LOG_ERR("UART_TX_ABORTED");
		k_sem_give(&uart_tx_sem);
		break;
	}
	case UART_RX_RDY:
	{
		LOG_DBG("UART_RX_RDY");
		uart_data_rx_rdy_handler(dev, event->data.rx);
		break;
	}
	case UART_RX_BUF_REQUEST:
	{
		LOG_DBG("UART_RX_BUF_REQUEST");
		if (released_buf == &rx_buf[0]) {
			uart_rx_buf_rsp(dev, &rx_buf[0], 1);
		} else {
			uart_rx_buf_rsp(dev, &rx_buf[1], 1);
		}
		break;
	}
	case UART_RX_BUF_RELEASED:
	{
		LOG_DBG("UART_RX_BUF_RELEASED");
		released_buf = event->data.rx_buf.buf;
		break;
	}
	case UART_RX_DISABLED:
	{
		LOG_DBG("UART_RX_DISABLED");
		break;
	}
	case UART_RX_STOPPED:
	{
		LOG_DBG("UART_RX_STOPPED: Reason: %d", event->data.rx_stop.reason);
		break;
	}
	default:
		LOG_ERR("Unknown UART event type %d", event->type);
		break;
	}
}

int uart_send(const struct device *dev, uint8_t *data, uint32_t len, uint32_t type, uint32_t id, uint32_t addr)
{
	uint8_t *pos;
	uint8_t *msg = k_malloc(len + sizeof(struct uart_msg));
	if (!msg){
		LOG_ERR("Unable to allocate msg");
		return -ENOMEM;
	}

	pos = msg;
	memcpy(pos, &len, sizeof(uint32_t));

	pos = pos + sizeof(uint32_t);
	memcpy(pos, &type, sizeof(uint32_t));

	pos = pos + sizeof(uint32_t);
	memcpy(pos, &id, sizeof(uint32_t));

	pos = pos + sizeof(uint32_t);
	memcpy(pos, &addr, sizeof(uint32_t));

	pos = pos + sizeof(uint32_t);
	memcpy(pos, data, len);
	// LOG_HEXDUMP_INF(data, len, "message:");
	k_fifo_put(&tx_fifo, msg);
	
	return 0;
}

int init_uart(const struct device *uart_dev, struct uart_msg_handlers *handlers)
{
	int err = 0;
	k_thread_create(&uart_rx_thread_thread, uart_rx_thread_stack, 
		CONFIG_UART_RX_THREAD_STACK_SIZE, uart_rx_thread_fn, 
		(void*)uart_dev, handlers, NULL, 
		CONFIG_UART_RX_THREAD_PRIORITY, 0, K_NO_WAIT);
	
	k_thread_create(&uart_tx_thread_thread, uart_tx_thread_stack, 
		CONFIG_UART_TX_THREAD_STACK_SIZE, uart_tx_thread_fn, 
		(void*)uart_dev, NULL, NULL, 
		CONFIG_UART_TX_THREAD_PRIORITY, 0, K_NO_WAIT);

	if (!device_is_ready(uart_dev))
	{
		LOG_ERR("UART device not ready");
		return -ENODEV;
	}
	LOG_DBG("UART device ready");

	err = uart_callback_set(uart_dev, uart_callback, handlers);
	if (err)
	{
		LOG_ERR("Failed to set UART callback: Error %d", err);
		return err;
	}

	k_fifo_init(&rx_fifo);
	k_fifo_init(&tx_fifo);

	uart_rx_enable(uart_dev, &rx_buf[0], 1, SYS_FOREVER_US);
	return 0;
}

static void uart_rx_thread_fn(void *arg1, void *arg2, void *arg3)
{
	LOG_DBG("Starting UART rx thread");
	struct uart_msg *msg;
	const struct device *dev = (const struct device *)arg1;
	struct uart_msg_handlers *handlers = (struct uart_msg_handlers *)arg2;
	while (true)
	{
		msg = k_fifo_get(&rx_fifo, K_FOREVER);
		LOG_INF("rx_thread");
		if (handlers) {
			if (handlers->rx){
				handlers->rx(dev, msg->data, msg->header.len, msg->header.type, msg->header.id, msg->header.addr);
			}
		}

		k_free(msg->data);
		k_free(msg);
	}
}

static void uart_tx_thread_fn(void *arg1, void *arg2, void *arg3)
{
	LOG_DBG("Starting UART tx thread");
	int err;
	uint8_t *msg;
	const struct device *dev = (const struct device *)arg1;
	size_t size;
	while (true)
	{
		msg = k_fifo_get(&tx_fifo, K_FOREVER);
		size = *msg + sizeof(struct uart_msg_header);

		err = uart_tx(dev, msg, size, SYS_FOREVER_US);
		if (err){
			LOG_ERR("Failed to send data: Error %d", err);
		}

		err = k_sem_take(&uart_tx_sem, K_FOREVER);
		if (err){
			LOG_ERR("Failed to take semaphore: Error %d", err);
		}
	}
}
```
