## applications/mesh_bot/drivers/stspin240/Kconfig
```kconfig
menu "STSPIN240 driver"
config STSPIN240
    bool "Enable STSPIN240 dual brushed DC motor driver"
    depends on PWM && GPIO

if STSPIN240
    module = STSPIN240_DRIVER
    module-str = STSPIN240 driver
    source "subsys/logging/Kconfig.template.log_config"

    module = STSPIN240_MOTOR_DRIVER
    module-str = STSPIN240 motor driver
    source "subsys/logging/Kconfig.template.log_config"
endif
endmenu
```

## applications/mesh_bot/src/modules/Kconfig.led
```kconfig
menuconfig LED_MODULE
    bool "Led module"
    default y
    help
      Enables led module.

if LED_MODULE

    config LED_THREAD_STACK_SIZE
        int "Stack size for led module thread"
        default 2048

    module = LED_MODULE
    module-str = Led module
    source "subsys/logging/Kconfig.template.log_config"

endif
```

## applications/robot_wars/gateway/src/modules/Kconfig.mesh_module
```kconfig
#
# Copyright (c) 2021 Nordic Semiconductor
#
# SPDX-License-Identifier: LicenseRef-Nordic-5-Clause
#

menu "MESH module"

config MESH_THREAD_STACK_SIZE
	int "Mesh module thread stack size"
	default 2048

config UART_RX_THREAD_STACK_SIZE
	int "UART thread stack size"
	default 2048

config UART_RX_THREAD_PRIORITY
	int "UART thread priority"
	default 5

config UART_TX_THREAD_STACK_SIZE
	int "UART thread stack size"
	default 2048

config UART_TX_THREAD_PRIORITY
	int "UART thread priority"
	default 5

module = MESH_MODULE
module-str = Mesh module
source "subsys/logging/Kconfig.template.log_config"
	  
endmenu
```

## samples/gateway_nRF9160/src/modules/Kconfig.mesh_module
```kconfig
#
# Copyright (c) 2021 Nordic Semiconductor
#
# SPDX-License-Identifier: LicenseRef-Nordic-5-Clause
#

menu "MESH module"

config MESH_THREAD_STACK_SIZE
	int "Mesh module thread stack size"
	default 2048

module = MESH_MODULE
module-str = Mesh module
source "subsys/logging/Kconfig.template.log_config"
	  
endmenu
```

## samples/gateway_nRF9160/src/modules/Kconfig.uart_module
```kconfig
#
# Copyright (c) 2021 Nordic Semiconductor
#
# SPDX-License-Identifier: LicenseRef-Nordic-5-Clause
#

menu "UART module"

config UART_THREAD_STACK_SIZE
	int "Uart module thread stack size"
	default 2048

config UART_RX_THREAD_STACK_SIZE
	int "UART thread stack size"
	default 2048

config UART_RX_THREAD_PRIORITY
	int "UART thread priority"
	default 5

config UART_TX_THREAD_STACK_SIZE
	int "UART thread stack size"
	default 2048

config UART_TX_THREAD_PRIORITY
	int "UART thread priority"
	default 5

module = UART_MODULE
module-str = Uart module
source "subsys/logging/Kconfig.template.log_config"
	  
endmenu
```

## subsys/bluetooth/mesh/vnd/Kconfig
```kconfig
#
# Copyright (c) 2021 Nordic Semiconductor ASA
#
# SPDX-License-Identifier: LicenseRef-Nordic-5-Clause
#

menu "Vendor models"

menuconfig BT_MESH_ID_CLI
	bool "Identity Client"
	select BT_MESH_VENDOR_MODELS
	help
	  Enable Mesh Identity Client model.

menuconfig BT_MESH_ID_SRV
	bool "Identity Server"
	select BT_MESH_VENDOR_MODELS
	help
	  Enable Mesh Identity Server model.

config BT_MESH_ID_LEN
	int "ength of id"
	depends on BT_MESH_ID_SRV || BT_MESH_ID_CLI
	default 6
	help
	  Length of identity data in bytes.

menuconfig BT_MESH_MOVEMENT_SRV
	bool "Movement Server"
	select BT_MESH_VENDOR_MODELS
	help
	  Enable Mesh Movement Server model.

menuconfig BT_MESH_MOVEMENT_CLI
	bool "Movement Server"
	select BT_MESH_VENDOR_MODELS
	help
	  Enable Mesh Movement Client model.

menuconfig BT_MESH_ROBOT_SRV
	bool "Robot Server"
	select BT_MESH_VENDOR_MODELS
	select BT_MESH_ID_SRV
	select BT_MESH_MOVEMENT_SRV
	help
	  Enable Mesh Robot Server model.

menuconfig BT_MESH_ROBOT_CLI
	bool "Robot Server"
	select BT_MESH_VENDOR_MODELS
	select BT_MESH_ID_CLI
	select BT_MESH_MOVEMENT_CLI
	help
	  Enable Mesh Robot Client model.

endmenu
```
